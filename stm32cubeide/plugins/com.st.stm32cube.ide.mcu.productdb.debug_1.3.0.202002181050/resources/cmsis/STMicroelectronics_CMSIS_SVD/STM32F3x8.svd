# STM32F3x8 register map
File version: 1.5
CPU: CM4 r1p0, little endian, no MPU, no FPU, 3 interrupt priority bits
Registers are 32-bit, read-write, reset 0x0 unless marked. A register's access mark holds for its fields unless they carry their own. Offsets are from the block's base; lines under a group give offsets from that group; [hi:lo] are bit positions; {n}, {i} and the like mark numbered series; 'fields as' and 'values as' point back to an identical list; <NAME> marks a mode.

## Memory map
0x40000000 TIM2 size 0x400 — General purpose timer
0x40000400 TIM3 size 0x400 — General purpose timer
0x40000800 TIM4 size 0x400
0x40000C00 TIM5 size 0x400 — General purpose timer
0x40001000 TIM6 size 0x400 — Basic timers
0x40001400 TIM7 size 0x400
0x40001800 TIM12 size 0x400 — General purpose timers
0x40001C00 TIM13 size 0x400 — General purpose timers
0x40002000 TIM14 size 0x400
0x40002800 RTC size 0x400 — Real-time clock
0x40002C00 WWDG size 0x400 — Window watchdog
0x40003000 IWDG size 0x400 — Independent watchdog
0x40003400 I2S2ext size 0x400
0x40003800 SPI2 size 0x400
0x40003C00 SPI3 size 0x400
0x40004000 I2S3ext size 0x400
0x40004400 USART2 size 0x400
0x40004800 USART3 size 0x400
0x40004C00 UART4 size 0x400
0x40005000 UART5 size 0x400
0x40005400 I2C1 size 0x400 — Inter-integrated circuit
0x40005800 I2C2 size 0x400
0x40005C00 USB size 0x400 — Universal serial bus full-speed device interface
0x40006400 CAN size 0x400 — Controller area network
0x40007000 PWR size 0x400 — Power control
0x40007400 DAC1 size 0x400 — Digital-to-analog converter
0x40007800 I2C3 size 0x400
0x40009800 DAC2 size 0x400 — Digital-to-analog converter
0x40009C00 TIM18 size 0x400
0x40010000 SYSCFG_COMP_OPAMP size 0x400 — System configuration controller
0x40010400 EXTI size 0x400 — External interrupt/event controller
0x40012C00 TIM1 size 0x400 — Advanced timer
0x40013000 SPI1 size 0x400 — Serial peripheral interface/Inter-IC sound
0x40013400 TIM8 size 0x400
0x40013800 USART1 size 0x400 — Universal synchronous asynchronous receiver transmitter
0x40013C00 SPI4 size 0x400
0x40014000 TIM15 size 0x400 — General purpose timers
0x40014400 TIM16 size 0x400 — General-purpose-timers
0x40014800 TIM17 size 0x400
0x40015000 TIM20 size 0x400
0x40015C00 TIM19 size 0x400
0x40016000 SDADC1 size 0x400 — Sigma-delta analog-to-digital converter
0x40016400 SDADC2 size 0x400
0x40016800 SDADC3 size 0x400
0x40020000 DMA1 size 0x400 — DMA controller 1
0x40020400 DMA2 size 0x400
0x40021000 RCC size 0x400 — Reset and clock control
0x40022000 Flash size 0x400
0x40023000 CRC size 0x400 — cyclic redundancy check calculation unit
0x40024000 TSC size 0x400 — Touch sensing controller
0x48000000 GPIOA size 0x400 — General-purpose I/Os
0x48000400 GPIOB size 0x400 — General-purpose I/Os
0x48000800 GPIOC size 0x400 — General-purpose I/Os
0x48000C00 GPIOD size 0x400
0x48001000 GPIOE size 0x400
0x48001400 GPIOF size 0x400
0x48001800 GPIOG size 0x400
0x48001C00 GPIOH size 0x400
0x50000000 ADC1 size 0x400 — Analog to digital converter
0x50000400 ADC2 size 0x400 — Analog-to-Digital Converter
0xA0000400 FMC size 0xC00 — Flexible memory controller
0xE000E008 SCB_ACTRL size 0x5 — System control block ACTLR
0xE000E010 STK size 0x11 — SysTick timer
0xE000E100 NVIC size 0x355 — Nested Vectored Interrupt Controller
0xE000ED00 SCB size 0x41 — System control block
0xE000ED88 FPU_CPACR size 0x5 — Floating point unit CPACR
0xE000ED90 MPU size 0x15 — Memory protection unit
0xE000EF00 NVIC_STIR size 0x5 — Nested vectored interrupt controller
0xE000EF34 FPU size 0xD — Floting point unit
0xE0042000 DBGMCU size 0x400 — Debug support

## Interrupts
0 WWDG_IRQ (WWDG) — Window Watchdog interrupt
1 PVD_IRQ (EXTI) — Power voltage detector through EXTI line detection interrupt
2 TAMP_STAMP (EXTI) — Tamper and TimeStamp interrupts
3 RTC_WKUP (RTC) — RTC Wakeup interrupt through the EXTI line
4 FLASH_IRQ (Flash) — Flash global interrupt
5 RCC_IRQ (RCC) — RCC global interrupt
6 EXTI0 (EXTI) — EXTI Line0 interrupt
7 EXTI1 (EXTI) — EXTI Line3 interrupt
8 EXTI2_TSC (EXTI) — EXTI Line2 and Touch sensing interrupts
9 EXTI3 (EXTI) — EXTI Line3 interrupt
10 EXTI4 (EXTI) — EXTI Line4 interrupt
11 DMA1_CH1_IRQ (DMA1) — DMA1 channel 1 interrupt
12 DMA1_CH2_IRQ (DMA1) — DMA1 channel 2 interrupt
13 DMA1_CH3_IRQ (DMA1) — DMA1 channel 3 interrupt
14 DMA1_CH4_IRQ (DMA1) — DMA1 channel 4 interrupt
15 DMA1_CH5_IRQ (DMA1) — DMA1 channel 5 interrupt
16 DMA1_CH6_IRQ (DMA1) — DMA1 channel 6 interrupt
17 DMA1_CH7_IRQ (DMA1) — DMA1 channel 7 interrupt
18 ADC1_IRQ (ADC1) — ADC1 interrupt
19 CAN_TX_IRQ (CAN) — USB high priority/CAN_TX interrupt
20 CAN_RXD_IRQ (CAN) — USB low priority/CAN_RXD interrupt
21 CAN_RXI_IRQ (CAN) — CAN_RXI interrupt
22 CAN_SCE_IRQ (CAN) — CAN_SCE interrupt
23 EXTI9_5 (EXTI) — EXTI Line5 to Line9 interrupts
24 TIM15_IRQ (TIM15) — Timer 15 global interrupt
25 TIM16_IRQ (TIM16) — Timer 16 global interrupt
26 TIM17_IRQ (TIM17) — Timer 17 global interrupt
27 TIM18_DAC3_IRQ (TIM18) — Timer 18 global interrupt/DAC3 underrun interrupt
28 TIM2_IRQ (TIM2) — Timer 2 global interrupt
29 TIM3_IRQ (TIM3) — Timer 3 global interrupt
30 TIM4_IRQ (TIM4) — Timer 4 global interrupt
31 I2C1_EV_IRQ (I2C1) — I2C1_EV global interrupt/EXTI Line[3:2] interrupts
32 I2C1_ER_IRQ (I2C1) — I2C1_ER
33 I2C2_EV_IRQ (EXTI, I2C2) — I2C2_EV global interrupt/EXTI Line[4:2] interrupts
34 I2C2_ER_IRQ (I2C2) — I2C2_ER
35 SPI1_IRQ (SPI1) — SPI1 global interrupt
36 SPI2_IRQ (SPI2) — SPI2 global interrupt
37 USART1_IRQ (USART1) — USART1 global interrupt/EXTI25 (USART1 wakeup event)
38 USART2_IRQ (USART2) — USART2 global interrupt/EXTI26 (USART1 wakeup event)
39 USART3_IRQ (USART3) — USART3 global interrupt/EXTI28 (USART1 wakeup event)
40 EXTI15_10_IRQ (EXTI) — EXTI Line[15:10] interrupts
41 RTC_ALARM_IT_IRQ (RTC) — RTC alarm interrupt
43 TIM12_IRQ (TIM12) — Timer 12 global interrupt
44 TIM13_IRQ (TIM13) — Timer 13 global interrupt
45 TIM14_IRQ (TIM14) — Timer 14 global interrupt
46 TIM8_CC (TIM8) — TIM8 capture compare interrupt
47 ADC3 (ADC2) — ADC3 global interrupt
48 FMC — FSMC global interrupt
50 TIM5_IRQ (TIM5) — Timer 5 global interrupt
51 SPI3_IRQ (SPI3) — SPI3 global interrupt
52 UART4_EXTI34 (UART4) — UART4 global and EXTI Line 34 interrupts
53 UART5_EXTI35 (UART5) — UART5 global and EXTI Line 35 interrupts
54 TIM6_DAC1 (TIM6) — TIM6 global, DAC1 Cahnnel1 and Cahnnel2 underrun error Interrupts
55 TIM7_IRQ (TIM7) — Timer 7 global interrupt
56 DMA2_Channel1 (DMA2) — DMA2 channel1 global interrupt
57 DMA2_Channel2 (DMA2) — DMA2 channel2 global interrupt
58 DMA2_Channel3 (DMA2) — DMA2 channel3 global interrupt
59 DMA2_Channel4 (DMA2) — DMA2 channel4 global interrupt
60 DMA2_Channel5 (DMA2) — DMA2 channel5 global interrupt
61 ADC_SD1_IRQ (SDADC1) — ADC sigma delta 1 (SDADC1) global interrupt
62 ADC_SD2_IRQ (SDADC2) — ADC sigma delta 2 (SDADC2) global interrupt
63 ADC_SD3_IRQ (SDADC3) — ADC sigma delta 3 (SDADC3) global interrupt
66 COMP7 (EXTI) — COMP7 interrupt combined with EXTI Line 33
72 I2C3_EV (I2C3) — I2C3 Event interrupt
73 I2C3_ER (I2C3) — I2C3 Error interrupt
74 USB_HP_IRQ (USB) — USB high priority interrupt
75 USB_LP_IRQ (USB) — USB low priority interrupt
76 USB_WAKEUP_IRQ (USB) — USB wakeup interrupt
77 TIM20_BRK (TIM20) — TIM20 Break interrupt
78 TIM19_IRQ (TIM19) — Timer 19 global interrupt
79 TIM20_TRG_COM (TIM20) — TIM20 Trigger and Commutation interrupt
80 TIM20_CC (TIM20) — TIM20 Capture Compare interrupt
81 FPU — Floating point unit interrupt
